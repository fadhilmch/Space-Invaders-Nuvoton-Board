/*===================================================================================================================

EL4121 Embedded System Design 2015 / 2016
Project Name 		: SPACE INVADERS GAMES
Author					: 1. Fadhil Mochammad / 13212118
									2. Fauzan Akbar S. / 13212

====================================================================================================================*/

//-------------------------------------------------- Library --------------------------------------------------------
#include <stdio.h>	
#include <string.h>		
#include <stdlib.h>
#include "NUC1xx.h"
#include "SYS.h"
#include "GPIO.h"
#include "LCD.h"
#include "cmsis_os.h"
#include "Seven_Segment.h"
#include "Scankey.h"
#include "EEPROM_24LC64.h"
#include "I2C.h"

#define BLACK 0xFFFF
#define WHITE 0x0000

#define START 1 //State Intro menu
#define MENU 2 	//State Menu
#define PLAY 3 	//State Game
#define OVER 4 	//State Over

#define SOUND_OFF 0
#define SOUND_MENU 1
#define SOUND_START 2
#define SOUND_HIT 3
#define SOUND_WIN 4
#define SOUND_LOSE 5
#define SOUND_BONUS 6
#define SOUND_SPEED 7
#define SOUND_GOTHIT 8


#define MENU_0 0
#define MENU_PLAY 1
#define MENU_HELP 2
#define MENU_HIGHSCORE 3
#define MENU_HELP2 4
#define MENU_HELP3 5

#define ENABLE 1
#define DISABLE 0

#define WIN 1
#define LOSE 0

#define INITIAL_POST_BULLET -10


//-------------------------------------------------------------------------------------------------------
//																						Global Variabel
//-------------------------------------------------------------------------------------------------------

int keyin;
int level;
int state;
int sound;
int menu;
int init;
int game;
int digit=1;
int last_digit;
int digit1=0;
int last_digit1;
int temp_digit;
int temp_digit1;
int addr=0;
int temp_score;

char Text[25];
char Text1[25];
char Text2[25];
char Text3[25];
uint8_t HearthLeft;
uint8_t attack_posx;
uint8_t bonus_posx;
uint8_t speed_posx;
int8_t x,y;
int8_t i,j,h;
int8_t hit;
int16_t score;
int8_t alien_no;
int8_t count;
uint8_t count_speed=40;
int8_t alien1_x[5], alien1_y, alien1_speed;
int8_t alien2_x[5], alien2_y, alien2_speed;
int8_t alien3_x[5], alien3_y, alien3_speed;
int8_t alien4_x[5], alien4_y, alien4_speed;	
int8_t cannon_x;
int8_t cannon_y;
	
int8_t bullet_x;
int8_t bullet_y;
int8_t attack_bullet_x;
int8_t attack_bullet_y;
int8_t bonus_x;
int8_t bonus_y;
int8_t speed_x;
int8_t speed_y;
	
int8_t bullet_speed;	
	
int8_t alien_map[5*5];
int8_t alien_score[5] = {60, 6, 5, 4, 2};

uint8_t active_bullet=1;
uint8_t active_attack_bullet=1;
uint8_t active_bonus=1;
uint8_t active_speed=1;
uint8_t active_speed_count=0;
	
uint8_t attack_bullet_speed = 1;

uint8_t highscore[15];


// bitmap is in upside down order
unsigned char bmp_bullet[8] = {
	0x00,0x00,0x18,0x18,0x18,0x18,0x00,0x00};
unsigned char bmp_attack_bullet[8] = {
	0x00,0x00,0x18,0x18,0x18,0x18,0x00,0x00};
unsigned char bmp_Cannon[8] = {
0x80,0x70,0xC8,0xFE,0xFE,0xC8,0x70,0x80};
unsigned char bmp_bonus[8] = {
	0x1C,0x3E,0x7E,0xFC,0xFC,0x7E,0x3E,0x1C};
unsigned char bmp_speed[8] = {
	0x00,0x98,0xDC,0x7E,0x3B,0x19,0x08,0x00};
unsigned char bmp_Alien1[16] = {
	0x00,0x00,0x70,0x18,0x7D,0x36,0x34,0x3C,0x3C,0x34,0x36,0x7D,0x18,0x70,0x00,0x00};
unsigned char bmp_Alien2[16] = {
	0x00,0x5C,0x30,0x1E,0x3F,0x1A,0x1A,0x1E,0x1E,0x1A,0x1A,0x3F,0x1E,0x30,0x5C,0x00};
unsigned char bmp_Alien3[16] = {
	0x00,0x00,0x98,0xD1,0x79,0x3F,0x7A,0x7F,0x7F,0x7A,0x3F,0x79,0xD1,0x98,0x00,0x00};
unsigned char bmp_Alien4[16] = {
	0x00,0x00,0x00,0x08,0x4C,0x2E,0x5B,0x2F,0x2F,0x5B,0x2E,0x4C,0x08,0x00,0x00,0x00};

unsigned char bmp_embedded[128*8] = {
0xFF,0xFF,0xFF,0x07,0x07,0x07,0x07,0x07,0x07,0x07,0x07,0x07,0x07,0x07,0x07,0x07,
0x07,0x07,0x07,0x07,0x07,0x07,0x07,0x07,0x07,0x07,0x07,0x07,0x07,0x07,0x07,0x07,
0x07,0x07,0x07,0x07,0xE7,0xE7,0x67,0x67,0x67,0x67,0x67,0x67,0x67,0x67,0x07,0x07,
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0xE0,0xE0,0xE0,0xE0,0xE0,0xE0,0xE0,0xE0,0xE0,0xE0,0xE0,0xE0,0xE0,0xFF,0xFF,0xFF
};

unsigned char bmp_nama[128*8] = {
0xFF,0xFF,0xFF,0xFF,0xFF,0xFF,0xFF,0xFF,0xFF,0xFF,0xFF,0xFF,0xFF,0xFF,0xFF,0xFF,
0xFF,0xFF,0xFF,0xFF,0xFF,0xFF,0xFF,0xFF,0xFF,0xFF,0xFF,0xFF,0xFF,0xFF,0xFF,0x07,
0x07,0x67,0x67,0x67,0x67,0x67,0x67,0xE7,0xE7,0xFF,0xFF,0x1F,0x1F,0x67,0x67,0x67,
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0xFF,0xFF,0xFF,0xFF,0xFF,0xFF,0xFF,0xFF,0xFF,0xFF,0xFF,0xFF,0xFF,0xFF,0xFF,0xFF
};

unsigned char GameTitle1[128*8] = {
0xFF,0xFF,0xFF,0xFF,0xFF,0xFF,0xFF,0xFF,0xFF,0xFF,0xFF,0xFF,0xFF,0xFF,0xFF,0xFF,
0xFF,0xFF,0xFF,0xFF,0xFF,0xFF,0xFF,0xFF,0xFF,0xFF,0xFF,0xFF,0xFF,0xFF,0xFF,0xFF,
0xFF,0xFF,0xFF,0xFF,0x1F,0x1F,0x1F,0x1F,0x1F,0xFF,0xFF,0xFF,0xFF,0xFF,0xFF,0xE1,
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0xE7,0xFF,0xE0,0xE0,0xFF,0xFF,0xFF,0xFC,0xF8,0xF1,0xE3,0xE7,0xFF,0xFF,0xFF,0xFF
};

unsigned char GameTitle2[128*8] = {
0xFF,0xFF,0xFF,0xFF,0xFF,0xFF,0xFF,0xFF,0xFF,0xFF,0xFF,0xFF,0xFF,0xFF,0xFF,0xFF,
0xFF,0xFF,0xFF,0xFF,0xFF,0xFF,0xFF,0xFF,0xFF,0xFF,0xFF,0xFF,0xFF,0xFF,0xFF,0xFF,
0xFF,0xFF,0xFF,0xFF,0xFF,0xFF,0xFF,0xFF,0xFF,0xFF,0xFF,0xFF,0xFF,0xFF,0xFF,0xE1,
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0xE7,0xFF,0xE0,0xE0,0xFF,0xFF,0xFF,0xFC,0xF8,0xF1,0xE3,0xE7,0xFF,0xFF,0xFF,0xFF
};

unsigned char bmp_game_title [128*8] = {
0x00,0x00,0x00,0x00,0x00,0x00,0x00,0x00,0x00,0x00,0x00,0x00,0x00,0x00,0x00,0x00,
0x00,0x80,0x80,0x00,0xC0,0x60,0xE0,0x30,0x00,0x00,0x00,0x00,0x00,0x00,0x00,0x00,
0x00,0x00,0x00,0x00,0x00,0x18,0x3C,0x37,0x1A,0x0B,0x08,0x00,0x00,0x00,0xC0,0xC0,
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0x3C,0x3C,0x3C,0x3C,0x3C,0x3F,0x3F,0x3F,0x3F,0x1F,0x1F,0x00,0x00,0x00,0x00,0x00
};

unsigned char bmp_mainmenu[128*8] = {
0xFE,0xFE,0xFE,0xFE,0xFE,0xFE,0xFE,0xFE,0xFE,0xFE,0xFE,0xFE,0xFE,0xFE,0xFE,0x06,
0x06,0x9E,0x9E,0x7E,0x7E,0x9E,0x9E,0x06,0x06,0xFE,0xFE,0x1E,0x1E,0x66,0x66,0x66,
0x66,0x66,0x66,0x1E,0x1E,0xFE,0xFE,0xE6,0xE6,0xE6,0xE6,0x06,0x06,0xE6,0xE6,0xE6,
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0x03,0x03,0x03,0x03,0x00,0x00,0x00,0x00,0x00,0x00,0x00,0x00,0x00,0x00,0x00,0x00
};

unsigned char bmp_help[128*8] = {
0xFE,0xFE,0xFE,0xFE,0xFE,0xFE,0xFE,0xFE,0xFE,0xFE,0xFE,0xFE,0xFE,0xFE,0xFE,0xFE,
0xFE,0xFE,0xFE,0xFE,0xFE,0xFE,0xFE,0xFE,0xFE,0xFE,0xFE,0xFE,0xFE,0xFE,0xFE,0xFE,
0xFE,0xFE,0xFE,0xFE,0xFE,0xFE,0xFE,0xFE,0xFE,0xFE,0x06,0x06,0x7E,0x7E,0x7E,0x7E,
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0x00,0x08,0x06,0x01,0x06,0x06,0x08,0x00,0x00,0x00,0x0F,0x00,0x00,0x00,0x00,0x00
};

unsigned char bmp_highscore [128*8] = {
0xFE,0xFE,0xFE,0xFE,0xFE,0xFE,0xFE,0xFE,0xFE,0xFE,0xFE,0xFE,0x06,0x06,0x7E,0x7E,
0x7E,0x7E,0x7E,0x7E,0x06,0x06,0xFE,0xFE,0xE6,0xE6,0xE6,0xE6,0x06,0x06,0xE6,0xE6,
0xE6,0xE6,0xFE,0xFE,0x1E,0x1E,0xE6,0xE6,0x66,0x66,0x66,0x66,0x66,0x66,0xFE,0xFE,
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0x00,0x00,0x00,0x00,0x00,0x00,0x00,0x00,0x00,0x00,0x00,0x00,0x00,0x00,0x00,0x00
};

unsigned char bmp_win[128*8] = {
0xFE,0xFC,0xFD,0xFB,0xF3,0xE7,0xEF,0xCF,0xDF,0xBF,0x3F,0x7F,0x7F,0xFF,0xFF,0xFF,
0xFF,0xFF,0xFF,0xFF,0xFF,0xFE,0xFD,0xFD,0xFB,0xF7,0xF7,0xEF,0x7F,0x3F,0x3F,0x1F,
0x1F,0x1F,0x1F,0x3F,0xFF,0xFC,0xF9,0xF7,0xFF,0xFF,0x7F,0x1E,0x0F,0x0F,0x07,0x07,
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0xDF,0xBF,0x7F,0x7F,0xFF,0xFF,0xFF,0xFF,0xFE,0xFE,0xFE,0xFC,0xFC,0xF9,0xF9,0xF9
};

//-------------------------------------------------------------------------------------------------------------------
//																									Thread ID of Task
//-------------------------------------------------------------------------------------------------------------------

osThreadId id_task1; // task1 at priority 1
osThreadId id_task_display; // task2 at priority 1
osThreadId id_task_scankey; // task2 at priority 1
osThreadId id_task_buzzer; // task2 at priority 1
osThreadId id_task_led; // task2 at priority 1

void task1 (void const *argument);
void task_scankey (void const *argument);
void task_display (void const *argument);
void task_buzzer (void const *argument);
void task_led (void const *argument);

osThreadDef(task1, osPriorityNormal, 1, 0);
osThreadDef(task_scankey, osPriorityHigh, 1, 0);
osThreadDef(task_display, osPriorityAboveNormal, 1, 0);
osThreadDef(task_buzzer, osPriorityBelowNormal, 1, 0);
osThreadDef(task_led, osPriorityNormal, 1, 0);

osMutexId mutex1;
osMutexDef (mutex1);

osMutexId mutex2;
osMutexDef (mutex2);


osMutexId mutex3;
osMutexDef (mutex3);

osMutexId mutex4;
osMutexDef (mutex4);

void Init_Buzz(void);
void Heart(void);
void init_LCD_backlight(void); 	
void sort_highscore(void);



int main (void)
{
	UNLOCKREG();
  DrvSYS_Open(30000000); // set CPU clock to 50MHz
	LOCKREG();
	
	init_LCD();
	clear_LCD(); // clear LCD
	OpenKeyPad();
	Init_Buzz();
	DrvGPIO_InitFunction(E_FUNC_I2C1); 
	//init_LCD_backlight();
	draw_LCD(bmp_embedded);   // draw Game Title scene
	osDelay(4000);
	draw_LCD(bmp_nama);   // draw Game Title scene
	osDelay(4000);
	clear_LCD();
	osDelay(500);
	draw_LCD(bmp_game_title);   // draw Game Title scene
	osDelay(5000);
	clear_LCD();
	osDelay(500);
	
	id_task_scankey = osThreadCreate(osThread(task_scankey), NULL);
	id_task_buzzer = osThreadCreate(osThread(task_buzzer), NULL);
	id_task_display = osThreadCreate(osThread(task_display), NULL);
	id_task_led = osThreadCreate(osThread(task_led), NULL);
	id_task1 = osThreadCreate(osThread(task1), NULL);
	
	
	mutex1 = osMutexCreate(osMutex(mutex1));
	mutex2 = osMutexCreate(osMutex(mutex2));
	mutex3 = osMutexCreate(osMutex(mutex3));
	mutex4 = osMutexCreate(osMutex(mutex4));
	
	
	state = START;
	sound = SOUND_OFF;
	menu = MENU_0;
	init = 0;
	
	
	for(h=0;h<4;h++)
	{
		highscore[h]=Read_24LC64(0x00000000+h);
	}
	sort_highscore();
	while(1){
		//Scheduler for Task
		osDelay(500);
		osSignalSet(id_task_scankey, 0x0001);
		osDelay(500);
		osSignalSet(id_task_display, 0x0002); 
		osDelay(500);
		osSignalSet(id_task_led, 0x0003); 
		osDelay(500);
		osSignalSet(id_task_buzzer, 0x0004); 
		osDelay(500);
		osSignalSet(id_task1, 0x0005); 
	}
}

void sort_highscore(void)
{
	int p,temp;
	for (p=0;p<4;p++)
	{
		if(temp_score>highscore[p])
		{
			temp = temp_score;
			temp_score = highscore[p];
			highscore[p] = temp;
		}
	}
	for(p=0;p<4;p++)
	{
		Write_24LC64(0x00000000+p,highscore[p]);
	}
	sprintf(Text1,"1. Score : %d",highscore[1]);
	sprintf(Text2,"2. Score : %d",highscore[2]);
	sprintf(Text3,"3. Score : %d",highscore[3]);
}
void Init_Buzz(void)
{
	DrvGPIO_Open(E_GPB, 11, E_IO_OUTPUT);
	DrvGPIO_SetBit(E_GPB, 11);
}

void init_LCD_backlight(void)
{
	DrvGPIO_Open(E_GPD, 14, E_IO_OUTPUT); 
	DrvGPIO_ClrBit(E_GPD, 14); 
}


void Hearth(uint8_t _HearthLeft){
	DrvGPIO_ClrBit(E_GPC, 12);
	DrvGPIO_ClrBit(E_GPC, 13);
	DrvGPIO_ClrBit(E_GPC, 14);
	DrvGPIO_ClrBit(E_GPC, 15);
	switch(_HearthLeft){
			case 0 :
				DrvGPIO_SetBit(E_GPC, 12);
				DrvGPIO_SetBit(E_GPC, 13);
				DrvGPIO_SetBit(E_GPC, 14);
				DrvGPIO_SetBit(E_GPC, 15);
				break;
			case 1 :
				DrvGPIO_SetBit(E_GPC, 12);
				DrvGPIO_SetBit(E_GPC, 13);
				DrvGPIO_SetBit(E_GPC, 14);
				break;
			case 2 :
				DrvGPIO_SetBit(E_GPC, 12);
				DrvGPIO_SetBit(E_GPC, 13);
				break;
			case 3 :
				DrvGPIO_SetBit(E_GPC, 12);
				break;
			default:
				break;
	}
}


void task1(void const *argument)
{
	int indi_sound_start = 1;
	for(;;)
	{
		if (state==START)
		{
			if(indi_sound_start==1)
			{
				sound = SOUND_START;
			}
			indi_sound_start=0;
			if (keyin!=0)
				state=MENU;
		}
		else if (state==MENU)
		{
			if (menu == MENU_0)
			{
				if (keyin == 1)
				{
					menu = MENU_PLAY;
					state = PLAY;
					clear_LCD();
					
				}
				else if (keyin == 2)
				{
					menu = MENU_HELP;
					clear_LCD();
					osDelay(700);
				}
				else if (keyin == 3)
				{
					menu = MENU_HIGHSCORE;
					clear_LCD();
					osDelay(700);
				}
			}
			else if (menu == MENU_HELP)
			{
				if (keyin == 1)
				{
					menu = MENU_0;
					clear_LCD();
					osDelay(700);
				}
				else if (keyin ==3)
				{
					menu = MENU_HELP2;
					clear_LCD();
					osDelay(700);
				}
			}
			else if (menu == MENU_HELP2)
			{
				if (keyin == 1)
				{
					menu = MENU_HELP;
					clear_LCD();
					osDelay(700);
				}
				else if (keyin ==3)
				{
					menu = MENU_HELP3;
					clear_LCD();
					osDelay(700);
				}
			}
			else if (menu == MENU_HELP3)
			{
				if (keyin == 1)
				{
					menu = MENU_HELP2;
					clear_LCD();
					osDelay(700);
				}
				else if (keyin ==3)
				{
					menu = MENU_0;
					clear_LCD();
					osDelay(700);
				}
			}
			else if (menu == MENU_HIGHSCORE)
			{
				//-------------------------------------------------------------------->  DIISI HIGHSCORE
				if (keyin == 1)
				{
					menu = MENU_0;
					clear_LCD();
					osDelay(400);
				}
				else if (keyin ==9)
				{
					for(i=0;i<4;i++)
					{
						Write_24LC64(0x00000000+i,0);
					}		
				}
			}
		}
		else if (state == OVER)
		{
			osDelay(2000);
			if(keyin!=0)
			{
				state=MENU;
				menu=MENU_0;
			}
		}
		osSignalWait(0x0005, 100);
	}
}

void task_buzzer (void const *argument)
{
	for(;;)
	{
		if (state == MENU)
		{
			if (keyin !=0)
			{
				sound = SOUND_HIT;
			}
		}
		if (sound==SOUND_OFF)
		{}
		else if (sound == SOUND_START)
		{
			DrvGPIO_ClrBit(E_GPB, 11);
			osDelay(200);
			DrvGPIO_SetBit(E_GPB, 11);
			osDelay(50);
			DrvGPIO_ClrBit(E_GPB, 11);
			osDelay(200);
			DrvGPIO_SetBit(E_GPB, 11);
			DrvGPIO_ClrBit(E_GPB, 11);
			osDelay(200);
			DrvGPIO_SetBit(E_GPB, 11);
			sound = SOUND_OFF;
		}
		else if (sound==SOUND_HIT)
		{
	
			DrvGPIO_ClrBit(E_GPB, 11);
			osDelay(30);
			DrvGPIO_SetBit(E_GPB, 11);
			sound=SOUND_OFF;
			osDelay(200);
		}
		else if (sound==SOUND_WIN)
		{
			DrvGPIO_ClrBit(E_GPB, 11);
			osDelay(200);
			DrvGPIO_SetBit(E_GPB, 11);
			osDelay(50);
			DrvGPIO_ClrBit(E_GPB, 11);
			osDelay(200);
			DrvGPIO_SetBit(E_GPB, 11);
			sound=SOUND_OFF;
		}
		else if (sound==SOUND_GOTHIT)
		{
			DrvGPIO_ClrBit(E_GPB, 11);
			osDelay(20);
			DrvGPIO_SetBit(E_GPB, 11);
			osDelay(200);
			DrvGPIO_ClrBit(E_GPB, 11);
			osDelay(20);
			DrvGPIO_SetBit(E_GPB, 11);
			osDelay(200);
			sound = SOUND_OFF;
		}
		else if (sound==SOUND_BONUS)
		{
			DrvGPIO_ClrBit(E_GPB, 11);
			osDelay(20);
			DrvGPIO_SetBit(E_GPB, 11);
			osDelay(200);
			DrvGPIO_ClrBit(E_GPB, 11);
			osDelay(20);
			DrvGPIO_SetBit(E_GPB, 11);
			osDelay(200);
			DrvGPIO_ClrBit(E_GPB, 11);
			osDelay(20);
			DrvGPIO_SetBit(E_GPB, 11);
			osDelay(200);
			sound = SOUND_OFF;
		}
		else if (sound==SOUND_SPEED)
		{
			DrvGPIO_ClrBit(E_GPB, 11);
			osDelay(20);
			DrvGPIO_SetBit(E_GPB, 11);
			osDelay(50);
			DrvGPIO_ClrBit(E_GPB, 11);
			osDelay(100);
			DrvGPIO_SetBit(E_GPB, 11);
			osDelay(50);
			sound = SOUND_OFF;
		}
		else if (sound== SOUND_WIN)
		{
				DrvGPIO_ClrBit(E_GPB, 11);
				osDelay(100);
				DrvGPIO_SetBit(E_GPB, 11);
				osDelay(50);
				DrvGPIO_ClrBit(E_GPB, 11);
				osDelay(400);
				DrvGPIO_SetBit(E_GPB, 11);
				sound=SOUND_OFF;
		}
		else
			{
				DrvGPIO_ClrBit(E_GPB, 11);
				osDelay(100);
				DrvGPIO_SetBit(E_GPB, 11);
				osDelay(50);
				DrvGPIO_ClrBit(E_GPB, 11);
				osDelay(100);
				DrvGPIO_SetBit(E_GPB, 11);
				sound=SOUND_OFF;
			}
	
		
		osSignalWait(0x0004, 100);
	}
}



void task_led (void const *argument)
{
	for(;;)
	{
		if (state == START)
		{
			DrvGPIO_ClrBit(E_GPC, 12);
			DrvGPIO_SetBit(E_GPC, 13);
			DrvGPIO_SetBit(E_GPC, 14);
			DrvGPIO_SetBit(E_GPC, 15);
			osDelay(100);
			DrvGPIO_SetBit(E_GPC, 12);
			DrvGPIO_ClrBit(E_GPC, 13);
			DrvGPIO_SetBit(E_GPC, 14);
			DrvGPIO_SetBit(E_GPC, 15);
			osDelay(100);
			DrvGPIO_SetBit(E_GPC, 12);
			DrvGPIO_SetBit(E_GPC, 13);
			DrvGPIO_ClrBit(E_GPC, 14);
			DrvGPIO_SetBit(E_GPC, 15);
			osDelay(100);
			DrvGPIO_SetBit(E_GPC, 12);
			DrvGPIO_SetBit(E_GPC, 13);
			DrvGPIO_SetBit(E_GPC, 14);
			DrvGPIO_ClrBit(E_GPC, 15);
			osDelay(100);
		}
		else if (state == MENU)
		{
			DrvGPIO_SetBit(E_GPC, 12);
			DrvGPIO_SetBit(E_GPC, 13);
			DrvGPIO_SetBit(E_GPC, 14);
			DrvGPIO_SetBit(E_GPC, 15);
		}
		else if (state ==OVER)
		{
			if(game==WIN)
			{
				DrvGPIO_ClrBit(E_GPC, 12);
			DrvGPIO_SetBit(E_GPC, 13);
			DrvGPIO_SetBit(E_GPC, 14);
			DrvGPIO_SetBit(E_GPC, 15);
			osDelay(100);
			DrvGPIO_SetBit(E_GPC, 12);
			DrvGPIO_ClrBit(E_GPC, 13);
			DrvGPIO_SetBit(E_GPC, 14);
			DrvGPIO_SetBit(E_GPC, 15);
			osDelay(100);
			DrvGPIO_SetBit(E_GPC, 12);
			DrvGPIO_SetBit(E_GPC, 13);
			DrvGPIO_ClrBit(E_GPC, 14);
			DrvGPIO_SetBit(E_GPC, 15);
			osDelay(100);
			DrvGPIO_SetBit(E_GPC, 12);
			DrvGPIO_SetBit(E_GPC, 13);
			DrvGPIO_SetBit(E_GPC, 14);
			DrvGPIO_ClrBit(E_GPC, 15);
			osDelay(100);
			}
		}
		else if (state == PLAY)
		{
				osMutexWait(mutex2,0xffff);
				digit = score/10;
				osMutexRelease(mutex2);
				close_seven_segment();
				show_seven_segment(3,digit);
				osDelay(15);
					
				close_seven_segment();
				show_seven_segment(0,count_speed/4);
				osDelay(15);
			
				digit1 = score - digit*10;
				close_seven_segment();
				show_seven_segment(2,digit1);
				osDelay(1);
				
				
		}
		osSignalWait(0x0003, 21);
	}
}
	
void task_display (void const *argument)
{
	int z =0;
	for(;;)
	{
		if (state==START)
		{
			menu = MENU_0;
			draw_LCD(GameTitle1);   // draw Game Title scene
			osDelay(600);
			draw_LCD(GameTitle2);   // draw Game Title scene
			osDelay(600);
		}
		else if(state==OVER)
		{
			if(game==WIN)
			{
				clear_LCD();
				sound = SOUND_WIN;
				draw_LCD(bmp_win);
				osDelay(2000);
			}
			else
			{
				clear_LCD(); // clear LCD
				x=0; y=32; printS_5x7(x,y,"  =====  YOU LOSE  =====  ");
				sound=SOUND_LOSE;
				osDelay(2000);
			}
			init=0;
		}
		else if (state==MENU)
		{
			if (menu == MENU_PLAY)
			{
				init = 0;
				menu=MENU_0;
			}
			else if (menu == MENU_HELP)
			{
				draw_LCD(bmp_help);
				draw_Bmp16x8(26,16,FG_COLOR,BG_COLOR, bmp_Alien1);	
				printS_5x7(46,16,"=  6 POINTS");
				draw_Bmp16x8(26,24,FG_COLOR,BG_COLOR, bmp_Alien2);	
				printS_5x7(46,24,"=  5 POINTS");
				draw_Bmp16x8(26,32,FG_COLOR,BG_COLOR, bmp_Alien3);	
				printS_5x7(46,32,"=  4 POINTS");	
				draw_Bmp16x8(26,40,FG_COLOR,BG_COLOR, bmp_Alien4);	
				printS_5x7(46,40,"=  2 POINTS");	
				
			}
			else if (menu == MENU_HELP2)
			{
				draw_LCD(bmp_help);
				printS_5x7(5, 20, "Push keypad(2) for Shoot");
				printS_5x7(5, 29, "Push keypad(4) for Left");
				printS_5x7(5, 38, "Push keypad(6) for Right ");
				printS_5x7(5, 47, "You only have 4 Lives ");	
			}
			else if (menu == MENU_HELP3)
			{
				draw_LCD(bmp_help);
				draw_Bmp8x8(4,16,FG_COLOR,BG_COLOR, bmp_bonus);	
				printS_5x7(24,16,"=  Extra Life");
				draw_Bmp8x8(4,24,FG_COLOR,BG_COLOR, bmp_speed);	
				printS_5x7(24,24,"=  Extra Shoot Speed");
				printS_5x7(26,35,"GET THE HIGHEST");	
				printS_5x7(46,43,"SCORE!");	
			}
			else if (menu == MENU_HIGHSCORE)
			{
				draw_LCD(bmp_highscore);
				printS_5x7(20, 24, Text1);	
				printS_5x7(20, 33, Text2);
				printS_5x7(20, 42, Text3);	
			}
			else if (menu==MENU_0)
				draw_LCD(bmp_mainmenu);
			else
				draw_LCD(bmp_mainmenu);
		}
		else if (state==PLAY)
		{
			
			if (init == 0)
			{
				alien1_speed = 1; 
				alien1_y     = 8;
	
				alien1_x[0] = 0; 
				alien1_x[1] = 16; 
				alien1_x[2] = 48; 
				alien1_x[3] = 64; 
				alien1_x[4] = 96;
	
				alien2_speed = 1; 
				alien2_y     = alien1_y+8;
	
				alien2_x[0] = 0; 
				alien2_x[1] = 16; 
				alien2_x[2] = 48; 
				alien2_x[3] = 64; 
				alien2_x[4] = 96; 
	
				alien3_speed = 1; 
				alien3_y     = alien1_y+16;
	
				alien3_x[0] = 0; 
				alien3_x[1] = 16; 
				alien3_x[2] = 48; 
				alien3_x[3] = 64; 
				alien3_x[4] = 96; 
	
				alien4_speed = 1; 
				alien4_y     = alien1_y+24;
	
				alien4_x[0] = 0; 
				alien4_x[1] = 16; 
				alien4_x[2] = 48; 
				alien4_x[3] = 64; 
				alien4_x[4] = 96;
	
				bullet_speed = 1;
				attack_bullet_speed = 1;
				hit=0; score=0; 
				cannon_x=56; cannon_y=56;	
				bullet_y= INITIAL_POST_BULLET;
	
				HearthLeft = 4;
				
				//represented alien as 1
				for (j=0; j<4; j++){
					for (i=0; i<5; i++){
						alien_map[j*5+i] = 1;
					}
				}
				init = 1;
			}
			else 
			{
				sprintf(Text,"  SCORE         ALIEN %2d", alien_no);	
				osMutexWait(mutex2,0xFFFF);
				temp_score = score;
				osMutexRelease(mutex2);
				
				y=0; x=0;	printS_5x7(x,y,Text);
		
				//Heart Left
				Hearth(HearthLeft);
		
				//random function to select the alien who shoot
				if(((unsigned char)rand()&0x07)>4){
					attack_posx = 4;
				}else{
					attack_posx = (unsigned char)rand()&0x03;
				}
		
				do{
					if(((unsigned char)rand()&0x07)>4){
				bonus_posx = 4;
			}else{
				bonus_posx = (unsigned char)rand()&0x03;
			}
		}while(attack_posx==bonus_posx);
		
		do{
			if(((unsigned char)rand()&0x07)>4){
				speed_posx = 4;
			}else{
				speed_posx = (unsigned char)rand()&0x03;
			}
		}while((bonus_posx==speed_posx)||attack_posx==speed_posx);
		
		//if not hit
	  if (hit==0){
		  // Display Ojbects : draw foreground color to display object
		  for (i=0; i<5; i++) {
			  if (alien_map[i]==1) 
					draw_Bmp16x8(alien1_x[i], alien1_y,FG_COLOR,BG_COLOR, bmp_Alien1);
				if (alien_map[5+i]==1)
					draw_Bmp16x8(alien2_x[i], alien2_y,FG_COLOR,BG_COLOR, bmp_Alien2);
				if (alien_map[10+i]==1)
					draw_Bmp16x8(alien3_x[i], alien3_y,FG_COLOR,BG_COLOR, bmp_Alien3);
				if (alien_map[15+i]==1)
					draw_Bmp16x8(alien4_x[i], alien4_y,FG_COLOR,BG_COLOR, bmp_Alien4);
			}
			
			//bullet not hit alien
			if(bullet_y>0){
				draw_Bmp8x8(bullet_x, bullet_y, FG_COLOR,BG_COLOR, bmp_bullet);
			}
			else{
				active_bullet = 1;
			}				
			
			//attack bullet not hit cannon
			if(attack_bullet_y<=56 && attack_bullet_y>0){
				draw_Bmp8x8(attack_bullet_x, attack_bullet_y, FG_COLOR,BG_COLOR, bmp_attack_bullet);
			}else{
				active_attack_bullet = 1;
			}
			
			//bonus
			if(bonus_y<=56 && bonus_y>0){
				draw_Bmp8x8(bonus_x, bonus_y, FG_COLOR,BG_COLOR, bmp_bonus);
			}else{
				active_bonus = 1;
			}
			
			//speed
			if(speed_y<=56 && speed_y>0){
				draw_Bmp8x8(speed_x, speed_y, FG_COLOR,BG_COLOR, bmp_speed);
			}else{
				active_speed = 1;
			}
			
			draw_Bmp8x8(cannon_x, cannon_y, FG_COLOR,BG_COLOR, bmp_Cannon);
			
			if(active_attack_bullet==1){
				if(alien_map[15+attack_posx]==1){
					attack_bullet_y = alien4_y+8;
					attack_bullet_speed = 3;
				}else if(alien_map[10+attack_posx]==1){
					attack_bullet_y = alien3_y+8;
					attack_bullet_speed = 4;
				}else if(alien_map[5+attack_posx]==1){
					attack_bullet_y = alien2_y+8;
					attack_bullet_speed = 6;
				}else if(alien_map[attack_posx]==1){
					attack_bullet_y = alien1_y+8;
					attack_bullet_speed = 7;
				}
				attack_bullet_x = alien1_x[attack_posx];
				active_attack_bullet=0;
			}
			
			if((active_bonus==1)&&(count==(rand()%0x2f))){
				if(alien_map[15+bonus_posx]==1){
					bonus_y = alien4_y+8;
				}else if(alien_map[10+bonus_posx]==1){
					bonus_y = alien3_y+8;
				}else if(alien_map[5+bonus_posx]==1){
					bonus_y = alien2_y+8;
				}else if(alien_map[bonus_posx]==1){
					bonus_y = alien1_y+8;
				}
				bonus_x = alien1_x[bonus_posx];
				active_bonus=0;
			}
			
			if((active_speed==1)&&(count==(rand()%0x3f))){
				if(alien_map[15+speed_posx]==1){
					speed_y = alien4_y+8;
				}else if(alien_map[10+speed_posx]==1){
					speed_y = alien3_y+8;
				}else if(alien_map[5+speed_posx]==1){
					speed_y = alien2_y+8;
				}else if(alien_map[speed_posx]==1){
					speed_y = alien1_y+8;
				}
				speed_x = alien1_x[speed_posx];
				active_speed=0;
			}
			
		 
			
			// Delay for Vision
		  osDelay(150);
		
		  // Erase Ojbects : draw background color at the ojbect location
		  for (i=0; i<5; i++) {
				draw_Bmp16x8(alien1_x[i], alien1_y,BG_COLOR,BG_COLOR, bmp_Alien1);
		    draw_Bmp16x8(alien2_x[i], alien2_y,BG_COLOR,BG_COLOR, bmp_Alien2);
		    draw_Bmp16x8(alien3_x[i], alien3_y,BG_COLOR,BG_COLOR, bmp_Alien3);
		    draw_Bmp16x8(alien4_x[i], alien4_y,BG_COLOR,BG_COLOR, bmp_Alien4);
      }
			
			if(bullet_y>0){
				draw_Bmp8x8(bullet_x, bullet_y, BG_COLOR,BG_COLOR, bmp_bullet);
			}	
			
			if(attack_bullet_y<=56 && attack_bullet_y>0){
				draw_Bmp8x8(attack_bullet_x, attack_bullet_y, BG_COLOR,BG_COLOR, bmp_attack_bullet);
			}	
			
			if(bonus_y<=56 && bonus_y>0){
				draw_Bmp8x8(bonus_x, bonus_y, BG_COLOR,BG_COLOR, bmp_bonus);
			}	
			
			if(speed_y<=56 && speed_y>0){
				draw_Bmp8x8(speed_x, speed_y, BG_COLOR,BG_COLOR, bmp_speed);
			}	
			
			draw_Bmp8x8(cannon_x, cannon_y, BG_COLOR,BG_COLOR, bmp_Cannon);
			
	    // Object Move by changing its x,y
		  //keyin=ScanKey(); 
		  osMutexWait(mutex1,0xFFFF);
			switch(keyin) {
				
				//if key4 press, move to the left
				case 4: cannon_x-=2;  
								break;
				//if key6 press, move to the right
				case 6: cannon_x+=2;  
								break;
				//if key2 press, shoot
				case 2: 
								if(active_bullet==1){
									bullet_x = cannon_x;
									bullet_y = cannon_y-8;
									active_bullet=0;
								}
								break;
				default:break;
		  }
			osMutexRelease(mutex1);
			//Move bullet
			if(bullet_y>0){
				bullet_y -= bullet_speed;
			}
			
			//Move attack bullet
			if(attack_bullet_y<=56 && attack_bullet_y>0){
				attack_bullet_y += attack_bullet_speed;
			}
			
			//Move bonus
			if(bonus_y<=56 && bonus_y>0){
				bonus_y += 1;
			}
			
			//Move speed
			if(speed_y<=56 && speed_y>0){
				speed_y += 1;
			}
			
	    
			//inc/dec Alien x for moving horizontally
			for (i=0; i<5; i++) {
				alien1_x[i] += alien1_speed;
				alien2_x[i] += alien2_speed;
				alien3_x[i] += alien3_speed;
				alien4_x[i] += alien4_speed;
			}
	 			
	    
			// Boundary Check : if >max, set to min; if <min, set to max;
			for (i=0; i<5; i++) {
				if (alien_map[i]==1){
		      if (alien1_x[i]<0){             
						alien1_x[i]=LCD_Xmax-16;
					}
		      if (alien1_x[i]>(LCD_Xmax-16)){ 
						alien1_x[i]=0;
					}						
				}
				if (alien_map[5+i]==1){
		      if (alien2_x[i]<0){
						alien2_x[i]=LCD_Xmax-16;
					}
		      if (alien2_x[i]>(LCD_Xmax-16)){ 
						alien2_x[i]=0;	
					}
				}
				if (alien_map[10+i]==1) {
		      if (alien3_x[i]<0){             
						alien3_x[i]=LCD_Xmax-16;
					}
		      if (alien3_x[i]>(LCD_Xmax-16)){ 
						alien3_x[i]=0;
					}						
				}
				if (alien_map[15+i]==1) {
		      if (alien4_x[i]<0){
						alien4_x[i]=LCD_Xmax-16;
					}
		      if (alien4_x[i]>(LCD_Xmax-16)){ 
						alien4_x[i]=0;
					}						
				}
			}
		  if (cannon_x>(LCD_Xmax-8)){	
				cannon_x=LCD_Xmax-8;
			}
      if (cannon_x<0){             
				cannon_x=0;
			}
				
	    
			// Collision Detection : check if Frog hit by Bus	
			for (i=0; i<5; i++) {
				if ((alien_map[i]!=0) && (bullet_y+4>=alien1_y && bullet_y+3<alien1_y+8)){
					if (bullet_x+4>=alien1_x[i] && bullet_x+3<alien1_x[i]+16) {
						hit=1; bullet_y=INITIAL_POST_BULLET; 
						osMutexWait(mutex2,0xFFFF);
						score+=alien_score[1]; 
						osMutexRelease(mutex2);
						alien_map[i]=0;active_bullet=1;sound=SOUND_HIT;
					}
				}
				if ((alien_map[5+i]!=0) && (bullet_y+4>=alien2_y && bullet_y+3<alien2_y+8)){					
					if (bullet_x+4>=alien2_x[i] && bullet_x+3<alien2_x[i]+16) {
						hit=1; bullet_y=INITIAL_POST_BULLET; 
						osMutexWait(mutex2,0xFFFF);
						score+=alien_score[2]; 
						osMutexRelease(mutex2);
						alien_map[5+i]=0;active_bullet=1;sound=SOUND_HIT;
					}
				}
				if ((alien_map[10+i]!=0) && (bullet_y+4>=alien3_y && bullet_y+3<alien3_y+8)){
					if (bullet_x+4>=alien3_x[i] && bullet_x+3<alien3_x[i]+16){
						hit=1; bullet_y=INITIAL_POST_BULLET; 
						osMutexWait(mutex2,0xFFFF);
						score+=alien_score[3]; 
						osMutexRelease(mutex2);
						alien_map[10+i]=0;active_bullet=1;sound=SOUND_HIT;
					}
				}
				if ((alien_map[15+i]!=0) &&	(bullet_y+4>=alien4_y && bullet_y+3<alien4_y+8)){
					if (bullet_x+4>=alien4_x[i] && bullet_x+3<alien4_x[i]+16){
						hit=1; bullet_y=INITIAL_POST_BULLET; 
						osMutexWait(mutex2,0xFFFF);
						score+=alien_score[4]; 
						osMutexRelease(mutex2);
						alien_map[15+i]=0;active_bullet=1;sound=SOUND_HIT;
					}
				}
	    }
			// Collision Detection : check if cannon hit by attack bullter
			if((attack_bullet_y>55) && ((attack_bullet_x>=cannon_x && attack_bullet_x<=cannon_x+4)||(attack_bullet_x+3>=cannon_x && attack_bullet_x+4<cannon_x+4))){
				active_attack_bullet = 1;HearthLeft--;attack_bullet_x=0;attack_bullet_y=0;sound=SOUND_GOTHIT; //Buzz(1);
				draw_Bmp8x8(attack_bullet_x, attack_bullet_y, BG_COLOR,BG_COLOR, bmp_attack_bullet);
			}
			
			// Collision Detection : check if cannon hit by bonus
			if((bonus_y>50) && ((bonus_x>=cannon_x && bonus_x<=cannon_x+4)||(bonus_x+3>=cannon_x && bonus_x+4<cannon_x+4))){
				active_bonus = 1;HearthLeft++;sound=SOUND_BONUS;//Buzz(1);
				if(HearthLeft>4){
					HearthLeft = 4;
				}
				bonus_x=0;bonus_y=0;
				draw_Bmp8x8(bonus_x, bonus_y, BG_COLOR,BG_COLOR, bmp_bonus);
			}
			
			// Collision Detection : check if cannon hit by speed
			if((speed_y>50) && ((speed_x>=cannon_x && speed_x<=cannon_x+4)||(speed_x+3>=cannon_x && speed_x+4<cannon_x+4))){
				active_speed = 1;speed_x=0;speed_y=0;bullet_speed+=4;active_speed_count=1;sound=SOUND_SPEED;//Buzz(1);
				draw_Bmp8x8(bonus_x, bonus_y, BG_COLOR,BG_COLOR, bmp_bonus);
			}
			
			
			//count alien left
			alien_no = 0;
			for (j=0; j<4; j++){
		    for (i=0; i<5; i++){
           alien_no = alien_no + alien_map[j*5+i];
				}
			}
			
			if(alien_no<15){
				if(alien_no<10){
					if(alien_no<5){
						if(alien_no<2){
							alien1_speed = 11;alien2_speed = 11; alien3_speed = 11;alien4_speed = 11;
						}
						alien1_speed = 9;alien2_speed = 9;alien3_speed = 9;alien4_speed = 9;
					}
					alien1_speed = 7;alien2_speed = 5;alien3_speed = 4;alien4_speed = 3;
				}
				alien1_speed = 5;alien2_speed = 4;alien3_speed = 3;alien4_speed = 2;
			}

			count++;
			if(count==100){
				count =0;
			}
			if(active_speed_count==1){
				count_speed--;
				
				
				if(count_speed<=0){
					active_speed_count=0;
					count_speed = 40;
					bullet_speed=1;
					//close_seven_segment();
				}
			}
		}
		
		else { 
			//Buzz(1); // buzz for hit
			hit=0; 			
			if (alien_no==0) {
				game = WIN;
				state = OVER;
				close_seven_segment();
				//temp_score = score;
				sort_highscore();
		  }		
	  }
		
		if(HearthLeft==0){
			game = LOSE;
			state=OVER;
			close_seven_segment();
			//temp_score = score;
			sort_highscore();
		}
			}
		}
		osSignalWait(0x0002, 100);
	}
}

void task_scankey (void const *argument)
{
for (;;) 
		{
			keyin=ScanKey(); //read input keypad and store to "keypad" variabel
			osDelay(100); //delay for stabilizing
			osSignalWait(0x0001, 100);   /* wait for an event flag 0x0001 or maximum 100ms*/
		}
}



